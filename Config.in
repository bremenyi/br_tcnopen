## Config.in
```kconfig
source "$BR2_EXTERNAL_TRDP_TEST_PATH/package/trdp/Config.in"
source "$BR2_EXTERNAL_TRDP_TEST_PATH/package/trdp_conftst/Config.in"
source "$BR2_EXTERNAL_TRDP_TEST_PATH/package/tcnopen/Config.in"
source "$BR2_EXTERNAL_TRDP_TEST_PATH/package/nt_conftest/Config.in"
```

## package/nt_conftest/Config.in
```kconfig
config BR2_PACKAGE_NT_CONFTEST
	bool "NT Conformance Test Application (DUT)"
	depends on BR2_TOOLCHAIN_HAS_THREADS
	depends on BR2_INSTALL_LIBSTDCPP
#	depends on BR2_PACKAGE_TRDP
	select BR2_PACKAGE_TCNOPEN
	select BR2_PACKAGE_UTIL_LINUX
	select BR2_PACKAGE_UTIL_LINUX_LIBUUID
	help
	  NT Conftest Application for DUT
	

#RMY prepared for separate build of TRDP/ TCNopen / Test Application
#if BR2_PACKAGE_XXXX
#
#config BR2_PACKAGE_XXXX_CLIENT
#	bool "XXXXclient"
#	default y
#	help
#	  XXXX client
#
#config BR2_PACKAGE_XXXX_SERVER
#	bool "XXXX-Server"
#	help
#	  XXXX server
#
#endif

comment "TRDP Conftest  needs a toolchain w/ C++, threads, dynamic library"
	depends on BR2_USE_MMU
	depends on !BR2_INSTALL_LIBSTDCPP || !BR2_TOOLCHAIN_HAS_THREADS \
		|| BR2_STATIC_LIBS
```

## package/tcnopen/Config.in
```kconfig
config BR2_PACKAGE_TCNOPEN
	bool "TCNOPEN Library"
	depends on BR2_TOOLCHAIN_HAS_THREADS
	depends on BR2_INSTALL_LIBSTDCPP
	select BR2_PACKAGE_UTIL_LINUX
	select BR2_PACKAGE_UTIL_LINUX_LIBUUID
	help
	  TCNOPEN Library

comment "TRDP needs a toolchain w/ C++, threads, dynamic library"
	depends on BR2_USE_MMU
	depends on !BR2_INSTALL_LIBSTDCPP || !BR2_TOOLCHAIN_HAS_THREADS \
		|| BR2_STATIC_LIBS
```

## package/trdp/Config.in
```kconfig
config BR2_PACKAGE_TRDP
	bool "TRDP Library"
	depends on BR2_TOOLCHAIN_HAS_THREADS
	depends on BR2_INSTALL_LIBSTDCPP
	select BR2_PACKAGE_UTIL_LINUX
	select BR2_PACKAGE_UTIL_LINUX_LIBUUID
	help
	  TRDP Library

#RMY prepared for separate build of TRDP/ TCNopen / Test Application
#if BR2_PACKAGE_XXXX
#
#config BR2_PACKAGE_XXXX_CLIENT
#	bool "XXXXclient"
#	default y
#	help
#	  XXXX client
#
#config BR2_PACKAGE_XXXX_SERVER
#	bool "XXXX-Server"
#	help
#	  XXXX server
#
#endif

comment "TRDP needs a toolchain w/ C++, threads, dynamic library"
	depends on BR2_USE_MMU
	depends on !BR2_INSTALL_LIBSTDCPP || !BR2_TOOLCHAIN_HAS_THREADS \
		|| BR2_STATIC_LIBS
```

## package/trdp_conftst/Config.in
```kconfig
config BR2_PACKAGE_TRDP_CONFTST
	bool "TRDP Conformance Test Application (DUT)"
	depends on BR2_TOOLCHAIN_HAS_THREADS
	depends on BR2_INSTALL_LIBSTDCPP
#	depends on BR2_PACKAGE_TRDP
	select BR2_PACKAGE_TRDP
	select BR2_PACKAGE_UTIL_LINUX
	select BR2_PACKAGE_UTIL_LINUX_LIBUUID
	help
	  TRDP Conftest Application for DUT
	

#RMY prepared for separate build of TRDP/ TCNopen / Test Application
#if BR2_PACKAGE_XXXX
#
#config BR2_PACKAGE_XXXX_CLIENT
#	bool "XXXXclient"
#	default y
#	help
#	  XXXX client
#
#config BR2_PACKAGE_XXXX_SERVER
#	bool "XXXX-Server"
#	help
#	  XXXX server
#
#endif

comment "TRDP Conftest  needs a toolchain w/ C++, threads, dynamic library"
	depends on BR2_USE_MMU
	depends on !BR2_INSTALL_LIBSTDCPP || !BR2_TOOLCHAIN_HAS_THREADS \
		|| BR2_STATIC_LIBS
```
